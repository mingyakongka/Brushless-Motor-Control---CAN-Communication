#include "mbotLinuxUsart.h"
#include "usart.h" //关于收发的串口定义在usert
#include "can.h"
#include "stdio.h"
#include "led.h"
//使用串口1 与上位机通讯
//硬件接口 PA9 PA10
//只预留通讯接口 接收后使用CAN转发给驱动器 再将驱动器的报文上传
//数据位 CAN_ID CAN_DLC DATA0 ---DATA3
/*--------------------------------发送协议-----------------------------------
//----------------55 aa size 00 00 00 00 00----------------------
//数据头55aa + CAN_ID + 数据 +
--------------------------------------------------------------------------*/

/*--------------------------------接收协议-----------------------------------
//----------------55 aa size 00 00 00 00 00---------------------
//数据头55aa + CAN_ID + 数据 + 
--------------------------------------------------------------------------*/


/**************************************************************************
通信的发送函数和接收函数必须的一些常量、变量、数组
**************************************************************************/
//数据接收暂存区
extern char  USART_RX_BUF[16]; //接收缓冲,16个字节.末字节为换行符       

/**************************************************************************
函数功能：通过串口中断服务函数，获取上位机发送的数据 转发给CAN
入口参数：
返回  值：无特殊意义
**************************************************************************/
void usartReceiveData(void)
{
	if( USART_RX_BUF[0]==0x55 && USART_RX_BUF[1] == 0xaa)//帧头正确
	{
			can_tx_inf_usart(01,USART_RX_BUF);
//		can_tx_duty_usart(USART_RX_BUF[2],USART_RX_BUF[3],USART_RX_BUF[4]);//发送接收到的指令给电机 控制占空比比

	}
}


/**************************************************************************
函数功能：电机的转速等信息进行打包，通过串口发送给Linux
入口参数：CAN接收数组
返回  值：无
**************************************************************************/
void usartSendData(char *Can_RX_Buff)
{
	//协议数据缓存数组
  char buf[20]={0};
	int i;
	//帧头
	buf[0]=0x55;
	buf[1]=0xaa;
	//设置发送数据

	for(i=2;i<20;i++)
	{
		buf[i]=Can_RX_Buff[i];                   // buf[2]data
	}
	//发送字符串数据
//	USART_Send_String(buf,sizeof(buf));
   
	for(i=0;i<20;i++)
	{
		USART_SendData(USART1,buf[i]);
		printf("发送给CAN的数据%c ",buf[i]);
	}
}
/**************************************************************************
函数功能：计算八位循环冗余校验，被usartSendData和usartReceiveOneData函数调用
入口参数：数组地址、数组大小
返回  值：CRC
**************************************************************************/
unsigned char getCrc8(unsigned char *ptr, unsigned short len)
{
	unsigned char crc;
	unsigned char i;
	crc = 0;
	while(len--)
	{
		crc ^= *ptr++;
		for(i = 0; i < 8; i++)
		{
			if(crc&0x01)
			{
        crc=(crc>>1)^0x8C;
			}
			else 
			{
        crc >>= 1;
			}
		}
	}
	return crc;
}
/**********************************END***************************************/










